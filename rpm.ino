/***
 * PROGRAM: CONECTION SERIAL WITH MAXTRACK TRACKER
 * DESENVOLVIDO POR DANIEL BENTO - @Dbent0
 * PROGRAMA PARA A CONFIGURAÇÃO DO MAXTRACK MTC500 VIA ARDUINO.
 * PROGRAM FOR THE CONFIGURATION OF THE MAXTRACK MTC500 VIA ARDUINO.
 ***/

char lerId[] = {0x01, 0x00, 0x00, 0x00, 0x00, 0x00, 0x00, 0x00, 0x00, 0x00, 0x00, 0x04}; // LEITURA ID
char lig_0[] = {0x01, 0x00, 0x00, 0x00, 0x29, 0x32, 0x33, 0x39, 0x33, 0x35, 0x00, 0x2F, 0x04}; // ALTERA STATUS ENTRADA 1
char lig_1[] = {0x01, 0x00, 0x00, 0x00, 0x29, 0x32, 0x33, 0x39, 0x33, 0x35, 0x01, 0x30, 0x04}; // ALTERA STATUS ENTRADA 2
char lig_2[] = {0x01, 0x00, 0x00, 0x00, 0x29, 0x32, 0x33, 0x39, 0x33, 0x35, 0x02, 0x31, 0x04}; // ALTERA STATUS ENTRADA 3
char lig_3[] = {0x01, 0x00, 0x00, 0x00, 0x29, 0x32, 0x33, 0x39, 0x33, 0x35, 0x03, 0x32, 0x04}; // ALTERA STATUS ENTRADA 4

// VETOR COMPLETO PARA CONFIGURAÇÃO DE RPM E HODOM
char rpm[]   = {0x01, 0x00, 0x00, 0x00, 0x3B, 0x32, 0x33, 0x39, 0x33, 0x35, 0x00, 0x00, 0x00,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 0xD3, 0x04};
// VETOR PARA ALTERAR TAXA DE TRANSMISSÃO
long int const taxa[]   = {9600, 19200, 38400, 57600, 115200, 230400}; 

char leitura[29]; // VETOR RESPOSTA EQUIPAMENTO

// VARIÁVEIS GLOBAIS UTILIZADAS
char receive[6];
int cond = 0;
int buttonState  = 0;
int buttonState2 = 0;
int pos_tax = 0;
int test = 0; // será 1 quando tiver na frêquencia correta.
char inicialBit;
char flag;
int cont;
int tam_rpm = 28*38 - 4;

void setup() {
  pinMode(5, OUTPUT);
  pinMode(6, INPUT);
  pinMode(7, INPUT);
}

//CÁLCULO PARA RETORNAR CHECKSUN DE CADA COMANDO ENVIADO
char checksun(char *vetor, int tam) {
char check = 0x00;
  for(int i = 1; i < (tam-2); i++) {
    check = vetor[i] + check;
  }
 return check;
}

void loop() {
  if(!test) {
    Serial.begin(taxa[pos_tax]); // altera taxa de transmissão
    // TESTE TAXA TRANSMISSÃO
    Serial.print("ENVIO: ");
    for(int i = 0; i <= 11; i++) {
      Serial.print(lerId[i]);
      delay(10);
    }
  Serial.print("\nRECEBER: ");
  inicialBit = Serial.read();
  Serial.print(inicialBit);
  
  if(inicialBit == 0x01) {
    test = 1;
    digitalWrite(5, HIGH);
    flag = inicialBit;
    for(int i = 0; i <= 28; i++) {
      leitura[i] = flag;
      flag = Serial.read();
      Serial.print(" ");
      Serial.print(flag, HEX);
      Serial.print(" ");
      if(i > 2 && i < 8) {
        // ALTERANDO SERIAL EQUIPAMENTO
        lig_0[i+2] = leitura[i];
        lig_1[i+2] = leitura[i];
        lig_2[i+2] = leitura[i];
        lig_3[i+2] = leitura[i];
        rpm[i+2]   = leitura[i];
      }
    }

    // CALCULANDO CHECKSUN PARA CADA COMANDO
    lig_0[11] = checksun(lig_0, 13);
    Serial.println(checksun(lig_0, 13), HEX);
    lig_1[11] = checksun(lig_1, 13);
    Serial.println(checksun(lig_1, 13), HEX);
    lig_2[11] = checksun(lig_2, 13);
    Serial.println(checksun(lig_2, 13), HEX);
    lig_3[11] = checksun(lig_3, 13);
    Serial.println(checksun(lig_3, 13), HEX);
    rpm[tam_rpm - 2] = checksun(rpm, tam_rpm);
    Serial.println(checksun(rpm, tam_rpm), HEX);
  
  } else {
    digitalWrite(5, LOW);
    delay(1000);
    digitalWrite(5, HIGH);
    delay(1000);
    digitalWrite(5, LOW);
    pos_tax++;
    if(pos_tax >= 7) pos_tax = 0;
    Serial.println("TAXA ALTERADA");  
    }
  } else {
    cont = 0;
    buttonState = digitalRead(7);
    buttonState2 = digitalRead(6);
    if (buttonState2 == HIGH) {
      do {
        for (int i = 0; i <= tam_rpm; i++) {
          Serial.print(rpm[i]);
          delay(3);
          }
          inicialBit = Serial.read(); 
         } while(inicialBit != 0x01);
      } else if (buttonState == HIGH) {
        do {
          for (int i = 0; i <= 12; i++) {
            Serial.print(lig_0[i]);
            delay(3);
            }
            inicialBit = Serial.read(); 
          } while (inicialBit != 0x01);
       }
       if(inicialBit == 0x01) {
       flag = inicialBit;
       for(int i = 0; i <= 5; i++) {
        receive[i] = flag;
        flag = Serial.read();
        Serial.println(receive[i]);
        } 
        delay(1000);
      }
  }
}
